## esp32_fw/main/Kconfig.projbuild
```kconfig
menu "ROS2Mower Configuration"

choice
    prompt "HW Variant"
    default ROS2NODE_HW_ROS2MOWER

    config ROS2NODE_HW_ROS2MOWER
        bool "ROS2Mower"

    config ROS2NODE_HW_ROS2ZUMO
        bool "ROS2Zumo"

    config ROS2NODE_HW_S2
        bool "ESP32-S2"

    config ROS2NODE_HW_S2_MOWER
        bool "ESP32-S2-MOWER"
endchoice

config WIFI_ROOMING_RSSI_THRESHOLD
    int "WiFi RSSI threshold to trigger roaming"
    default 0
    help
        WiFi RSSI threshold to trigger roaming value in dbm (-100 to 0). 0 denotes feature is disabled.

config ENABLE_WEBUI
	bool "Enable Web UI"
	default y

config ENABLE_SPIFS
	bool "Enable SPI File System"
	default n

config ENABLE_ROS2
	bool "Enable ROS2 Support"
	default n

config ENABLE_SDCARD
	bool "Enable SDCard Support"
	default y

config ENABLE_BUZZER
	bool "Enable Buzzer"
	default n


config ENABLE_CAMERA
	bool "Enable CAMERA Support"
	default n

config ENABLE_SPI
	bool "Enable SPI Support"
	default n

config ENABLE_I2C_SLAVE
	bool "Enable I2C SLave Support"
	default n

config ENABLE_I2C
	bool "Enable I2C Master Support"
	default n

if ENABLE_I2C
    config ENABLE_I2C_POWER
        bool "Enable I2C Power"
        default n
    config ENABLE_I2C_MOTOR
        bool "Enable I2C Motor"
        default n
    config ENABLE_I2C_OLED
        bool "Enable I2C OLED"
        default n
    config ENABLE_I2C_LDS
        bool "Enable I2C LDS"
        default n
    config ENABLE_I2C_OLED_SH1106
        bool "Enable I2C OLED SH1106"
        default n
    config ENABLE_I2C_BNO055
        bool "Enable I2C BNO055"
        default n
    config ENABLE_I2C_VL53L0X
        bool "Enable I2C VL53L0X"
        default n
    config ENABLE_I2C_VL53L1X
        bool "Enable I2C VL53L1X"
        default n
endif

config ENABLE_GPS
	bool "Enable GPS Support"
	default n

endmenu
```
